## components/bth_dc/Kconfig
```kconfig
menu "B-T HOME DC measurement"
config BTH_DC_CALIBRATION_PERMILLE
    int "DC voltage calibration multiplier (1000 = unchanged)"
    range 100 10000
    default 1000
    help
        Multiplies the voltage calculated from the physical divider ratio.
        Set to round(current value * reference voltage / reported voltage).
endmenu
```

## components/bth_heartbeat/Kconfig
```kconfig
menu "B-T HOME modules"
    config BTH_HEARTBEAT_ENABLED
        bool "Enable diagnostic heartbeat"
        default y

    config BTH_HEARTBEAT_INTERVAL_MS
        int "Heartbeat interval (ms)"
        depends on BTH_HEARTBEAT_ENABLED
        range 1000 3600000
        default 5000
endmenu
```

## components/bth_mains/Kconfig
```kconfig
menu "B-T HOME mains measurement"
config BTH_MAINS_MILLIVOLTS_PER_COUNT
    int "Calibrated mains millivolts per ADC RMS count (0 = uncalibrated)"
    range 0 100000
    default 0
    help
        Set to round(1000 * reference mains Vrms / reported ADC RMS).
        Includes the module gain and external voltage divider. Recalibrate
        after changing the potentiometer, divider or ADC.
endmenu
```

## components/bth_matter/Kconfig
```kconfig
menu "B-T HOME Matter"
    config BTH_MATTER_ENABLED
        bool "Matter relay over home Wi-Fi"
        depends on IDF_TARGET_ESP32C6 && BTH_WEB_RELAY_ENABLED && !BTH_ZIGBEE_ENABLED
        default n
        help
            Requires -DBTH_WITH_MATTER=ON and ESP-Matter 1.4.2 on Linux/WSL.
            Wi-Fi is provisioned by the Matter controller over BLE.
endmenu
```

## components/bth_startup_blink/Kconfig
```kconfig
menu "B-T HOME startup indication"
    config BTH_STARTUP_BLINK_COUNT
        int "Digit pulse count (0 disables digit only)"
        range 0 100
        default 5
    config BTH_STARTUP_BLINK_ON_MS
        int "Digit pulse duration (ms)"
        range 20 5000
        default 200
    config BTH_STARTUP_BLINK_OFF_MS
        int "Pause between digit pulses (ms)"
        range 20 5000
        default 200
    choice BTH_STARTUP_BLINK_POLARITY
        prompt "Digit indication mode"
        default BTH_STARTUP_BLINK_PULSE_LIGHT
        config BTH_STARTUP_BLINK_PULSE_LIGHT
            bool "Normally off, light pulses"
        config BTH_STARTUP_BLINK_PULSE_DARK
            bool "Normally on, dark pulses"
    endchoice
    config BTH_STARTUP_BLINK_REPEAT_PAUSE_MS
        int "Pause before and between digit groups (ms)"
        range 200 10000
        default 2000
endmenu
```

## components/bth_zigbee/Kconfig
```kconfig
menu "B-T HOME Zigbee"
    config BTH_ZIGBEE_ENABLED
        bool "Enable Zigbee relay endpoint"
        depends on IDF_TARGET_ESP32C6 && BTH_WEB_RELAY_ENABLED
        select ZB_ENABLED
        default n
        help
            Standard HA On/Off output on endpoint 1. BOOT selects Zigbee or Wi-Fi
            configuration mode; they never run simultaneously. A confirmed BOOT
            GPIO in the board profile is required. Short BOOT press starts pairing.
            Requires a zb_storage NVS partition. MOES/Tuya compatibility needs device testing.
endmenu
```

## main/Kconfig.projbuild
```kconfig
menu "B-T HOME application"
    config BTH_WEB_RELAY_ENABLED
        bool "Enable relay and authenticated web control"
        default y
        help
            Runs the relay control page over a Wi-Fi AP, or optional Matter Wi-Fi.
            Relay GPIO and polarity must be specified by the board profile.
    config BTH_LOOP_INTERVAL_MS
        int "Module polling interval (ms)"
        range 10 1000
        default 20
        help
            All module tick callbacks run sequentially in the application task.
            Keep callbacks short; use a module-owned task for blocking I/O.
            Boards with ADC, BOOT or startup LED require at most 50 ms;
            application.cpp rejects slower polling for these profiles.
endmenu
```
